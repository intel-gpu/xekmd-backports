## backport/Kconfig.integrate
```kconfig
config BACKPORT_INTEGRATE
	bool
	def_bool y

config BACKPORT_DIR
	string
	default "%%BACKPORT_DIR%%"

config BACKPORTS_RELEASE_TAG
	string
	default "%%BACKPORTS_RELEASE_TAG%%"

config BASE_KERNEL_HEAD
	string
	default "%%BASE_KERNEL_HEAD%%"

config BASE_KERNEL_NAME
	string
	default "%%BASE_KERNEL_NAME%%"

config TARGET_KERNEL_VERSION
	string
	option env="TARGET_KERNEL_VERSION"

menuconfig BACKPORT_LINUX
	bool "Backport %%BASE_KERNEL_NAME%% %%BASE_KERNEL_HEAD%% (backports %%BACKPORTS_RELEASE_TAG%%)"
	default n
	---help---
	  Enabling this will let give you the opportunity to use features and
	  drivers backported from %%BASE_KERNEL_NAME%% %%BASE_KERNEL_HEAD%%
	  on the kernel your are using. This is experimental and you should
	  say no unless you'd like to help test things or want to help debug
	  this should we run into any issues.

if BACKPORT_LINUX

source "$BACKPORT_DIR/Kconfig.versions"
source "$BACKPORT_DIR/Kconfig.sources"
source "$BACKPORT_DIR/Kconfig.local"

endif # BACKPORT_LINUX
```

## backport/Kconfig.package
```kconfig
mainmenu "Backports from $BASE_KERNEL_NAME $BASE_KERNEL_HEAD (backports $BACKPORTS_RELEASE_TAG)"

config BACKPORT_DIR
	string
	option env="BACKPORT_DIR"
	help
	   Path to current backport directory
config BACKPORTS_RELEASE_TAG
	string
	option env="BACKPORTS_RELEASE_TAG"
	help
	   Backports Releases Tag info
config BASE_KERNEL_HEAD
	string
	option env="BASE_KERNEL_HEAD"
	help
	   contains HEAD commit of base kernel
config BASE_KERNEL_NAME
	string
	option env="BASE_KERNEL_NAME"
	help
	   contains name of base kernel
config BASE_KERNEL_TAG
	string
	option env="BASE_KERNEL_TAG"
	help
	   contains Tag info of base kernel
config TARGET_KERNEL_NAME
	string
	option env="TARGET_KERNEL_NAME"
	help
	   Target kernel against which backport are created.
config OOT_BACKPORT
	string
	option env="OOT_BACKPORT"
	help
	   Macro to control backport specific features

# Packaging hacks
source "$BACKPORT_DIR/Kconfig.package.hacks"

# Code we backport
source "$BACKPORT_DIR/Kconfig.sources"

# these will be generated
source "$BACKPORT_DIR/Kconfig.kernel"
source "$BACKPORT_DIR/Kconfig.versions"
source "$BACKPORT_DIR/Kconfig.local"
```

## backport/Kconfig.sources
```kconfig
# this has the configuration for the backport code
source "$BACKPORT_DIR/compat/Kconfig"

# these are copied from the kernel
```

## backport/compat/Kconfig
```kconfig
#
# backport Kconfig
#
# Some options are user-selectable ("BPAUTO_USERSEL_*")
#
# Most options, however, follow a few different schemes:
#
# A) An option that is selected by drivers ("select FOO") will be
#    changed to "select BPAUTO_FOO" (if the option BPAUTO_FOO
#    exists). The option BPAUTO_FOO then controls setting of the
#    BPAUTO_BUILD_FOO option, which is a module, like this:
#
# config BPAUTO_BUILD_FOO
#	tristate
#	# or bool
#
#	# not possible on kernel < X.Y, build will fail if any
#	# drivers are allowed to build on kernels < X.Y
#	depends on KERNEL_X_Y
#
#	# don't build the backport code if FOO is in the kernel
#	# already, but only if the kernel version is also >= X.Z;
#	# this is an example of backporting where the version of
#	# the FOO subsystem that we need is only available from
#	# kernel version X.Z
#	depends on !FOO || KERNEL_X_Z
#
#	# build if driver needs it (it selects BPAUTO_FOO)
#	default m if BPAUTO_FOO
#
#	# or for build-testing (BPAUTO_USERSEL_BUILD_ALL is enabled)
#	default m if BPAUTO_USERSEL_BUILD_ALL
#
# config BPAUTO_FOO
#	bool
#
# This only works as-is if the kernel code is usable on any version,
# otherwise the "&& !FOO" part needs to be different.
#
#
# B) An option for code always present on some kernels (e.g. KFIFO).
#    This simply depends on/sets the default based on the version:
#
# config BPAUTO_BUILD_KFIFO
#	def_bool y
#	depends on KERNEL_2_6_36
#
#
# C) similarly, a kconfig symbol for an option, e.g.
#    BPAUTO_OPTION_SOME_FIX (no examples provided) check git log
#
#
# Variations are obviously possible.
#

config BP_MODULES
	option modules
	bool
	default MODULES

	help
	This symbol is necessary for the newer kconf tool, it looks
	for the "option modules" to control the 'm' state.

config BPAUTO_USERSEL_BUILD_ALL
	bool "Build all compat code"
	help
	  This option selects all the compat code options
	  that would otherwise only be selected by drivers.

	  It's only really useful for compat testing, so
	  you probably shouldn't enable it.

config KERNEL_5_15
        def_bool y
        depends on KERNEL_VERSION >= 331520 && KERNEL_VERSION < 331776
        help
          Kernel version 5.15 detected

config KERNEL_6_1
        def_bool y
        depends on KERNEL_VERSION >= 393472 && KERNEL_VERSION < 393728
        help
          Kernel version 6.1 detected

config KERNEL_6_6
        def_bool y
        depends on KERNEL_VERSION >= 394240 && KERNEL_VERSION < 409600
        help
          Kernel version 6.6 detected

config KERNEL_6_7
        def_bool y
        depends on KERNEL_VERSION >= 409600 && KERNEL_VERSION < 425984
        help
          Kernel version 6.7 detected

config BUILD_XE_DRM_GPUVM
        def_bool y
	depends on KERNEL_5_15 || KERNEL_6_1 || KERNEL_6_6 || KERNEL_6_7
        help
          Enable building of XE drm_gpuvm backport module.
          Only enabled for kernels 5.15,6.1,6.6 and 6.7 that need GPUVM backport.
          Disabled for 6.8+ kernels which have native GPUVM support.

config BUILD_XE_DRM_EXEC
        def_bool y
        depends on KERNEL_5_15 || KERNEL_5_16
        help
          Enable building of XE drm_exec backport module.
          Enabled for kernel 5.15 where drm_exec is not available.

config BUILD_XE_DRM_BUDDY
        def_bool y
        depends on KERNEL_5_15 || KERNEL_5_16
        help
        Enable building of XE drm_buddy backport module
        Enabled for kernel 5.15 where drm_buddy is not available.

config BUILD_XE_DRM_SUBALLOC_HELPER
       def_bool y
       depends on KERNEL_5_15 || KERNEL_5_16
       help
       Enable building of XE drm_suballoc backport module
       Enabled for kernel 5.15 where drm_suballoc is not available.
```

## src/Kconfig.versions
```kconfig
config KERNEL_6_15
    def_bool y
config KERNEL_6_16
    def_bool y
config KERNEL_6_17
    def_bool y
config KERNEL_6_18
    def_bool y
config KERNEL_6_19
    def_bool y
config KERNEL_6_20
    def_bool y
```

## src/drivers/gpu/drm/xe/Kconfig
```kconfig
# SPDX-License-Identifier: GPL-2.0-only
config DRM_GPUVM
	tristate "Enable Xe-specific DRM GPUVM support"
	depends on m
	depends on DRM
	depends on BUILD_XE_DRM_GPUVM
	default m
	help
	  GPU-VM representation providing helpers to manage a GPUs virtual
          address space (Xe-specific backport version)
config DRM_XE
	tristate "Intel Xe Graphics"
	depends on m
	depends on DRM && PCI && MMU && (m || (y && KUNIT=y))
	depends on INTERVAL_TREE
	# we need shmfs for the swappable backing store, and in particular
	# the shmem_readpage() which depends upon tmpfs
	depends on SHMEM
	depends on TMPFS
	depends on DRM_BUDDY
	#select DRM_CLIENT_SELECTION
	depends on DRM_EXEC
	#select DRM_KMS_HELPER
	select DRM_KUNIT_TEST_HELPERS if DRM_XE_KUNIT_TEST != n
	#select DRM_PANEL
	#select DRM_SUBALLOC_HELPER
	#select DRM_DISPLAY_DP_HELPER
	#select DRM_DISPLAY_DSC_HELPER
	#select DRM_DISPLAY_HDCP_HELPER
	#select DRM_DISPLAY_HDMI_HELPER
	#select DRM_DISPLAY_HELPER
	#select DRM_MIPI_DSI
	depends on RELAY
	depends on IRQ_WORK
	# xe depends on ACPI_VIDEO when ACPI is enabled
	# but for select to work, need to select ACPI_VIDEO's dependencies, ick
	select BACKLIGHT_CLASS_DEVICE if ACPI
	select INPUT if ACPI
	select ACPI_VIDEO if X86 && ACPI
	select X86_PLATFORM_DEVICES if X86 && ACPI
	select ACPI_WMI if X86 && ACPI
	depends on SYNC_FILE
	depends on IOSF_MBI
	depends on CRC32
	select SND_HDA_I915 if SND_HDA_CORE
	select CEC_CORE if CEC_NOTIFIER
	depends on VMAP_PFN
	depends on DRM_TTM
	depends on DRM_TTM_HELPER
	depends on DRM_EXEC
	select DRM_GPUVM if BUILD_XE_DRM_GPUVM
	depends on DRM_SCHED
	depends on MMU_NOTIFIER
	depends on WANT_DEV_COREDUMP
	depends on AUXILIARY_BUS
	depends on HMM_MIRROR
	help
	  Experimental driver for Intel Xe series GPUs

	  If "M" is selected, the module will be called xe.

config DRM_XE_DISPLAY
	bool "Enable display support"
	depends on n
	depends on DRM_XE && DRM_XE=m && HAS_IOPORT
	select FB_IOMEM_HELPERS if DRM_FBDEV_EMULATION
	depends on I2C
	depends on I2C_ALGOBIT
	default y
	help
	  Disable this option only if you want to compile out display support.

config DRM_XE_FORCE_PROBE
	string "Force probe xe for selected Intel hardware IDs"
	depends on DRM_XE
	help
	  This is the default value for the xe.force_probe module
	  parameter. Using the module parameter overrides this option.

	  Force probe the xe for Intel graphics devices that are
	  recognized but not properly supported by this kernel version. It is
	  recommended to upgrade to a kernel version with proper support as soon
	  as it is available.

	  It can also be used to block the probe of recognized and fully
	  supported devices.

	  Use "" to disable force probe. If in doubt, use this.

	  Use "<pci-id>[,<pci-id>,...]" to force probe the xe for listed
	  devices. For example, "4500" or "4500,4571".

	  Use "*" to force probe the driver for all known devices.

	  Use "!" right before the ID to block the probe of the device. For
	  example, "4500,!4571" forces the probe of 4500 and blocks the probe of
	  4571.

	  Use "!*" to block the probe of the driver for all known devices.

config PRELIM_DRM_XE_EUDEBUG
	bool "Enable gdb debugger support (eudebug)"
	depends on DRM_XE
	default y
	help
	  Choose this option if you want to add support for debugger (gdb) to
	  attach into process using Xe and debug the gpu/gpgpu programs.
	  With debugger support, Xe will provide interface for a debugger to
	  process to track, inspect and modify resources.

menu "drm/Xe Debugging"
depends on DRM_XE
depends on EXPERT
source "drivers/gpu/drm/xe/Kconfig.debug"
endmenu

menu "drm/xe Profile Guided Optimisation"
	visible if EXPERT
	depends on DRM_XE
	source "drivers/gpu/drm/xe/Kconfig.profile"
endmenu
```

## src/drivers/mtd/devices/Kconfig
```kconfig
# SPDX-License-Identifier: GPL-2.0-only
menu "Intel Discrete Graphics non-volatile memory driver"

config MTD_INTEL_DG
	tristate "Intel Discrete Graphics non-volatile memory driver"
	depends on m
	depends on AUXILIARY_BUS
	depends on MTD
	help
	  This provides an MTD device to access Intel Discrete Graphics
	  non-volatile memory.

	  To compile this driver as a module, choose M here: the module
	  will be called mtd-intel-dg.

endmenu
```
