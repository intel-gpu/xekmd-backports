## backport/Kconfig.drm_ras
```kconfig
# DRM RAS Configuration
config DRM_RAS
	tristate "DRM RAS support"
	depends on DRM
	depends on NET
	help
	  Enables the DRM RAS (Reliability, Availability and Serviceability)
	  support for DRM drivers. This provides a Generic Netlink interface
	  for error reporting and queries.
	  If in doubt, say "N".
```

## src/Kconfig.local
```kconfig
config BACKPORTED_BACKPORT_DIR
	tristate
	default BACKPORT_DIR
config BACKPORTED_BACKPORTS_RELEASE_TAG
	tristate
	default BACKPORTS_RELEASE_TAG
config BACKPORTED_BASE_KERNEL_HEAD
	tristate
	default BASE_KERNEL_HEAD
config BACKPORTED_BASE_KERNEL_NAME
	tristate
	default BASE_KERNEL_NAME
config BACKPORTED_BASE_KERNEL_TAG
	tristate
	default BASE_KERNEL_TAG
config BACKPORTED_TARGET_KERNEL_NAME
	tristate
	default TARGET_KERNEL_NAME
config BACKPORTED_OOT_BACKPORT
	tristate
	default OOT_BACKPORT
config BACKPORTED_BP_MODULES
	tristate
	default BP_MODULES
config BACKPORTED_BPAUTO_USERSEL_BUILD_ALL
	tristate
	default BPAUTO_USERSEL_BUILD_ALL
config BACKPORTED_KERNEL_5_15
	tristate
	default KERNEL_5_15
config BACKPORTED_KERNEL_6_1
	tristate
	default KERNEL_6_1
config BACKPORTED_KERNEL_6_6
	tristate
	default KERNEL_6_6
config BACKPORTED_KERNEL_6_7
	tristate
	default KERNEL_6_7
config BACKPORTED_BUILD_XE_DRM_GPUVM
	tristate
	default BUILD_XE_DRM_GPUVM
config BACKPORTED_BUILD_XE_DRM_EXEC
	tristate
	default BUILD_XE_DRM_EXEC
config BACKPORTED_BUILD_XE_DRM_BUDDY
	tristate
	default BUILD_XE_DRM_BUDDY
config BACKPORTED_BUILD_XE_DRM_SUBALLOC_HELPER
	tristate
	default BUILD_XE_DRM_SUBALLOC_HELPER
config BACKPORTED_BUILD_FULL_VFIO
	tristate
	default BUILD_FULL_VFIO
config BACKPORTED_VFIO_PCI_CORE
	tristate
	default VFIO_PCI_CORE
config BACKPORTED_DRM_SUBALLOC_HELPER
	tristate
	default DRM_SUBALLOC_HELPER
config BACKPORTED_DRM_BUDDY
	tristate
	default DRM_BUDDY
config BACKPORTED_DRM_EXEC
	tristate
	default DRM_EXEC
config BACKPORTED_DRM_GPUVM
	tristate
	default DRM_GPUVM
config BACKPORTED_DRM_XE
	tristate
	default DRM_XE
config BACKPORTED_DRM_XE_DISPLAY
	tristate
	default DRM_XE_DISPLAY
config BACKPORTED_DRM_XE_DP_TUNNEL
	tristate
	default DRM_XE_DP_TUNNEL
config BACKPORTED_DRM_XE_GPUSVM
	tristate
	default DRM_XE_GPUSVM
config BACKPORTED_DRM_XE_PAGEMAP
	tristate
	default DRM_XE_PAGEMAP
config BACKPORTED_DRM_XE_FORCE_PROBE
	tristate
	default DRM_XE_FORCE_PROBE
config BACKPORTED_PRELIM_DRM_XE_EUDEBUG
	tristate
	default PRELIM_DRM_XE_EUDEBUG
config BACKPORTED_DRM_XE_WERROR
	tristate
	default DRM_XE_WERROR
config BACKPORTED_DRM_XE_DEBUG
	tristate
	default DRM_XE_DEBUG
config BACKPORTED_DRM_XE_DEBUG_VM
	tristate
	default DRM_XE_DEBUG_VM
config BACKPORTED_DRM_XE_DEBUG_SRIOV
	tristate
	default DRM_XE_DEBUG_SRIOV
config BACKPORTED_DRM_XE_DEBUG_MEMIRQ
	tristate
	default DRM_XE_DEBUG_MEMIRQ
config BACKPORTED_DRM_XE_DEBUG_MEM
	tristate
	default DRM_XE_DEBUG_MEM
config BACKPORTED_DRM_XE_KUNIT_TEST
	tristate
	default DRM_XE_KUNIT_TEST
config BACKPORTED_DRM_XE_DEBUG_GUC
	tristate
	default DRM_XE_DEBUG_GUC
config BACKPORTED_DRM_XE_USERPTR_INVAL_INJECT
	tristate
	default DRM_XE_USERPTR_INVAL_INJECT
config BACKPORTED_DRM_XE_JOB_TIMEOUT_MAX
	tristate
	default DRM_XE_JOB_TIMEOUT_MAX
config BACKPORTED_DRM_XE_JOB_TIMEOUT_MIN
	tristate
	default DRM_XE_JOB_TIMEOUT_MIN
config BACKPORTED_DRM_XE_TIMESLICE_MAX
	tristate
	default DRM_XE_TIMESLICE_MAX
config BACKPORTED_DRM_XE_TIMESLICE_MIN
	tristate
	default DRM_XE_TIMESLICE_MIN
config BACKPORTED_DRM_XE_PREEMPT_TIMEOUT
	tristate
	default DRM_XE_PREEMPT_TIMEOUT
config BACKPORTED_DRM_XE_PREEMPT_TIMEOUT_MAX
	tristate
	default DRM_XE_PREEMPT_TIMEOUT_MAX
config BACKPORTED_DRM_XE_PREEMPT_TIMEOUT_MIN
	tristate
	default DRM_XE_PREEMPT_TIMEOUT_MIN
config BACKPORTED_DRM_XE_ENABLE_SCHEDTIMEOUT_LIMIT
	tristate
	default DRM_XE_ENABLE_SCHEDTIMEOUT_LIMIT
config BACKPORTED_MTD_INTEL_DG
	tristate
	default MTD_INTEL_DG
config BACKPORTED_INTEL_PMT_CLASS
	tristate
	default INTEL_PMT_CLASS
config BACKPORTED_INTEL_PMT_TELEMETRY
	tristate
	default INTEL_PMT_TELEMETRY
config BACKPORTED_INTEL_PMT_CRASHLOG
	tristate
	default INTEL_PMT_CRASHLOG
config BACKPORTED_INTEL_PMT_DISCOVERY
	tristate
	default INTEL_PMT_DISCOVERY
config BACKPORTED_INTEL_PMT_KUNIT_TEST
	tristate
	default INTEL_PMT_KUNIT_TEST
config BACKPORTED_INTEL_HID_EVENT
	tristate
	default INTEL_HID_EVENT
config BACKPORTED_INTEL_VBTN
	tristate
	default INTEL_VBTN
config BACKPORTED_INTEL_INT0002_VGPIO
	tristate
	default INTEL_INT0002_VGPIO
config BACKPORTED_INTEL_OAKTRAIL
	tristate
	default INTEL_OAKTRAIL
config BACKPORTED_INTEL_BXTWC_PMIC_TMU
	tristate
	default INTEL_BXTWC_PMIC_TMU
config BACKPORTED_INTEL_BYTCRC_PWRSRC
	tristate
	default INTEL_BYTCRC_PWRSRC
config BACKPORTED_INTEL_CHTDC_TI_PWRBTN
	tristate
	default INTEL_CHTDC_TI_PWRBTN
config BACKPORTED_INTEL_CHTWC_INT33FE
	tristate
	default INTEL_CHTWC_INT33FE
config BACKPORTED_INTEL_ISHTP_ECLITE
	tristate
	default INTEL_ISHTP_ECLITE
config BACKPORTED_INTEL_MRFLD_PWRBTN
	tristate
	default INTEL_MRFLD_PWRBTN
config BACKPORTED_INTEL_PUNIT_IPC
	tristate
	default INTEL_PUNIT_IPC
config BACKPORTED_INTEL_RST
	tristate
	default INTEL_RST
config BACKPORTED_INTEL_SDSI
	tristate
	default INTEL_SDSI
config BACKPORTED_INTEL_SMARTCONNECT
	tristate
	default INTEL_SMARTCONNECT
config BACKPORTED_INTEL_TPMI_POWER_DOMAINS
	tristate
	default INTEL_TPMI_POWER_DOMAINS
config BACKPORTED_INTEL_TPMI
	tristate
	default INTEL_TPMI
config BACKPORTED_INTEL_PLR_TPMI
	tristate
	default INTEL_PLR_TPMI
config BACKPORTED_INTEL_TURBO_MAX_3
	tristate
	default INTEL_TURBO_MAX_3
config BACKPORTED_INTEL_VSEC
	tristate
	default INTEL_VSEC
config BACKPORTED_INTEL_PMT_CLASS
	tristate
	default INTEL_PMT_CLASS
config BACKPORTED_INTEL_PMT_TELEMETRY
	tristate
	default INTEL_PMT_TELEMETRY
config BACKPORTED_INTEL_PMT_CRASHLOG
	tristate
	default INTEL_PMT_CRASHLOG
config BACKPORTED_INTEL_PMT_DISCOVERY
	tristate
	default INTEL_PMT_DISCOVERY
config BACKPORTED_INTEL_PMT_KUNIT_TEST
	tristate
	default INTEL_PMT_KUNIT_TEST
config BACKPORTED_VFIO
	tristate
	default VFIO
config BACKPORTED_VFIO_DEVICE_CDEV
	tristate
	default VFIO_DEVICE_CDEV
config BACKPORTED_VFIO_GROUP
	tristate
	default VFIO_GROUP
config BACKPORTED_VFIO_CONTAINER
	tristate
	default VFIO_CONTAINER
config BACKPORTED_VFIO_IOMMU_TYPE1
	tristate
	default VFIO_IOMMU_TYPE1
config BACKPORTED_VFIO_IOMMU_SPAPR_TCE
	tristate
	default VFIO_IOMMU_SPAPR_TCE
config BACKPORTED_VFIO_NOIOMMU
	tristate
	default VFIO_NOIOMMU
config BACKPORTED_VFIO_VIRQFD
	tristate
	default VFIO_VIRQFD
config BACKPORTED_VFIO_DEBUGFS
	tristate
	default VFIO_DEBUGFS
config BACKPORTED_VFIO_PCI_CORE
	tristate
	default VFIO_PCI_CORE
config BACKPORTED_VFIO_PCI_INTX
	tristate
	default VFIO_PCI_INTX
config BACKPORTED_VFIO_PCI
	tristate
	default VFIO_PCI
config BACKPORTED_VFIO_PCI_VGA
	tristate
	default VFIO_PCI_VGA
config BACKPORTED_VFIO_PCI_IGD
	tristate
	default VFIO_PCI_IGD
config BACKPORTED_VFIO_PCI_ZDEV_KVM
	tristate
	default VFIO_PCI_ZDEV_KVM
config BACKPORTED_MLX5_VFIO_PCI
	tristate
	default MLX5_VFIO_PCI
config BACKPORTED_HISI_ACC_VFIO_PCI
	tristate
	default HISI_ACC_VFIO_PCI
config BACKPORTED_PDS_VFIO_PCI
	tristate
	default PDS_VFIO_PCI
config BACKPORTED_VIRTIO_VFIO_PCI
	tristate
	default VIRTIO_VFIO_PCI
config BACKPORTED_VIRTIO_VFIO_PCI_ADMIN_LEGACY
	tristate
	default VIRTIO_VFIO_PCI_ADMIN_LEGACY
config BACKPORTED_NVGRACE_GPU_VFIO_PCI
	tristate
	default NVGRACE_GPU_VFIO_PCI
config BACKPORTED_QAT_VFIO_PCI
	tristate
	default QAT_VFIO_PCI
config BACKPORTED_XE_VFIO_PCI
	tristate
	default XE_VFIO_PCI
config BACKPORTED_VFIO_PLATFORM_BASE
	tristate
	default VFIO_PLATFORM_BASE
config BACKPORTED_VFIO_PLATFORM
	tristate
	default VFIO_PLATFORM
config BACKPORTED_VFIO_AMBA
	tristate
	default VFIO_AMBA
config BACKPORTED_VFIO_PLATFORM_CALXEDAXGMAC_RESET
	tristate
	default VFIO_PLATFORM_CALXEDAXGMAC_RESET
config BACKPORTED_VFIO_PLATFORM_AMDXGBE_RESET
	tristate
	default VFIO_PLATFORM_AMDXGBE_RESET
config BACKPORTED_VFIO_PLATFORM_BCMFLEXRM_RESET
	tristate
	default VFIO_PLATFORM_BCMFLEXRM_RESET
config BACKPORTED_VFIO_MDEV
	tristate
	default VFIO_MDEV
config BACKPORTED_VFIO_FSL_MC
	tristate
	default VFIO_FSL_MC
config BACKPORTED_VFIO_CDX
	tristate
	default VFIO_CDX
config BACKPORTED_XE_VFIO_PCI
	tristate
	default XE_VFIO_PCI
```

## src/Kconfig.sources
```kconfig
# this has the configuration for the backport code
source "$BACKPORT_DIR/compat/Kconfig"

# these are copied from the kernel
source "$BACKPORT_DIR/drivers/gpu/drm/xe/Kconfig"
source "$BACKPORT_DIR/drivers/mtd/devices/Kconfig"

# pmt
source "$BACKPORT_DIR/drivers/platform/x86/intel/pmt/Kconfig"
source "$BACKPORT_DIR/drivers/platform/x86/intel/Kconfig"

#VFIO
if BUILD_FULL_VFIO
source "$BACKPORT_DIR/drivers/vfio/Kconfig"
endif
if !BUILD_FULL_VFIO
source "$BACKPORT_DIR/drivers/vfio/pci/xe/Kconfig"
endif

# MEI
source "$BACKPORT_DIR/drivers/misc/mei/Kconfig"
source "$BACKPORT_DIR/drivers/misc/mei/hdcp/Kconfig"
source "$BACKPORT_DIR/drivers/misc/mei/gsc_proxy/Kconfig"
source "$BACKPORT_DIR/drivers/misc/mei/pxp/Kconfig"
```

## src/drivers/vfio/mdev/Kconfig
```kconfig
# SPDX-License-Identifier: GPL-2.0-only

config VFIO_MDEV
	tristate
	depends on m
```
